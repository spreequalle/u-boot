## board/checkpoint/l-50/Kconfig
```kconfig
if TARGET_L50

config SYS_BOARD
	default "l-50"

config SYS_VENDOR
	default "checkpoint"

config SYS_CONFIG_NAME
	default "l-50"

endif
```

## board/freecom/silverstore/Kconfig
```kconfig
if TARGET_SILVERSTORE

config SYS_BOARD
       default "silverstore"

config SYS_VENDOR
       default "freecom"

config SYS_CONFIG_NAME
       default "silverstore"

endif
```

## board/qnap/ts221/Kconfig
```kconfig
if TARGET_TS221

config SYS_BOARD
       default "ts221"

config SYS_VENDOR
       default "qnap"

config SYS_CONFIG_NAME
       default "ts221"

endif
```

## configs/l-50_defconfig
```kconfig
CONFIG_ARM=y
CONFIG_SYS_DCACHE_OFF=y
CONFIG_ARCH_CPU_INIT=y
CONFIG_KIRKWOOD=y
CONFIG_SYS_TEXT_BASE=0x600000
CONFIG_TARGET_L50=y
CONFIG_ENV_SIZE=0x20000
CONFIG_ENV_OFFSET=0xC0000
CONFIG_ENV_SECT_SIZE=0x20000
CONFIG_ENV_ADDR=0xC0000
CONFIG_IDENT_STRING="\nCheck Point L-50"
CONFIG_NR_DRAM_BANKS=2
# CONFIG_SYS_MALLOC_F is not set
CONFIG_BOOTDELAY=1
CONFIG_CONSOLE_MUX=y
CONFIG_DISPLAY_BOARDINFO=y
CONFIG_HUSH_PARSER=y
# CONFIG_CMD_FLASH is not set
#CONFIG_CMD_IDE=y
CONFIG_CMD_I2C=y
CONFIG_CMD_NAND=y
CONFIG_CMD_USB=y
# CONFIG_CMD_SETEXPR is not set
CONFIG_CMD_DHCP=y
CONFIG_CMD_MII=y
CONFIG_CMD_PING=y
CONFIG_CMD_EXT2=y
CONFIG_CMD_FAT=y
CONFIG_CMD_JFFS2=y
CONFIG_CMD_MTDPARTS=y
CONFIG_MTD=y
CONFIG_MTD_RAW_NAND=y
CONFIG_MTDIDS_DEFAULT="nand0=orion_nand"
CONFIG_MTDPARTS_DEFAULT="mtdparts=orion_nand:0xc0000@0x0(u-boot)ro,0x40000@0xc0000(bootldr-env),0x7900000@0x100000(ubi),0x800000@0x7a00000(kernel-2),0x7100000@0x8200000(rootfs-2),0x7900000@0xf300000(default_sw),0x1800000@0x16c00000(logs),0x100000@0x18400000(preset_cfg),0x100000@0x18500000(adsl),-@0x18600000(storage)"
CONFIG_CMD_UBI=y
CONFIG_ISO_PARTITION=y
CONFIG_OF_CONTROL=y
CONFIG_DEFAULT_DEVICE_TREE="kirkwood-l-50"
CONFIG_ENV_IS_IN_NAND=y
CONFIG_DM=y
CONFIG_DM_ETH=y
#CONFIG_MVSATA_IDE=y
CONFIG_MMC=y
CONFIG_MVGBE=y
CONFIG_MII=y
CONFIG_PHYLIB=y
CONFIG_PHY_MARVELL=y
CONFIG_MV88E61XX_SWITCH=y
CONFIG_MV88E61XX_CPU_PORT=6
CONFIG_MV88E61XX_PHY_PORTS=0x01f
CONFIG_MV88E61XX_FIXED_PORTS=0
#CONFIG_DM_RTC=y
#CONFIG_RTC_MV=y
CONFIG_SYS_NS16550=y
CONFIG_DM_I2C=y
CONFIG_SYS_I2C_MVTWSI=y
CONFIG_USB=y
CONFIG_USB_EHCI_HCD=y
CONFIG_USB_STORAGE=y
CONFIG_CMD_BOOTZ=y
CONFIG_FIT=y
CONFIG_FIT_VERBOSE=y
CONFIG_LZMA=y
CONFIG_LZO=y
```

## configs/nsa325_defconfig
```kconfig
CONFIG_ARM=y
CONFIG_SYS_DCACHE_OFF=y
CONFIG_ARCH_CPU_INIT=y
CONFIG_KIRKWOOD=y
CONFIG_SYS_TEXT_BASE=0x600000
CONFIG_TARGET_NSA325=y
CONFIG_IDENT_STRING="\nZyXEL NSA325 2-Bay Power Media Server"
CONFIG_NR_DRAM_BANKS=2
CONFIG_BOOTDELAY=3
CONFIG_SYS_PROMPT="NSA325> "
# CONFIG_CMD_IMLS is not set
# CONFIG_CMD_FLASH is not set
CONFIG_MVGBE=y
CONFIG_MII=y
CONFIG_SYS_NS16550=y
CONFIG_CMD_FDT=y
CONFIG_OF_LIBFDT=y
CONFIG_CMD_SETEXPR=y
CONFIG_CMD_DHCP=y
CONFIG_CMD_MII=y
CONFIG_CMD_PING=y
CONFIG_CMD_DNS=y
CONFIG_CMD_SNTP=y
CONFIG_CMD_USB=y
CONFIG_USB=y
CONFIG_CMD_DATE=y
CONFIG_CMD_EXT2=y
CONFIG_CMD_EXT4=y
CONFIG_CMD_FAT=y
CONFIG_CMD_JFFS2=y
CONFIG_MTD=y
CONFIG_MTD_RAW_NAND=y
CONFIG_MTDPARTS_DEFAULT="mtdparts=orion_nand:0x0c0000(uboot),0x80000(uboot_env),0x7ec0000(ubi)"
CONFIG_CMD_MTDPARTS=y
CONFIG_CMD_ENV=y
CONFIG_CMD_NAND=y
CONFIG_EFI_PARTITION=y
CONFIG_ENV_IS_IN_NAND=y
CONFIG_ENV_SIZE=0x20000
CONFIG_ENV_OFFSET=0xC0000
CONFIG_ENV_SECT_SIZE=0x20000
CONFIG_ENV_ADDR=0xC0000
CONFIG_CMD_UBI=y
CONFIG_USB_EHCI_HCD=y
CONFIG_USB_STORAGE=y
CONFIG_LZMA=y
CONFIG_LZO=y
CONFIG_SYS_LONGHELP=y
```
